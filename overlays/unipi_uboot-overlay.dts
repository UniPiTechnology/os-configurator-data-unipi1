/dts-v1/;
/plugin/;

/ {

	fragment@0 {
		target = <&i2c1>;

		__overlay__ {
			#address-cells = <1>;
			#size-cells = <0>;
			status = "okay";

			unipi_mb: eeprom@50 {
				compatible = "atmel,24c02";
				reg = <0x50>;
				read-only;
				status = "okay";
			};
		};
	};

	fragment@1 {
		target-path = "/aliases";
		__overlay__ {
			unipi-mb = &unipi_mb;
		};
	};
};
