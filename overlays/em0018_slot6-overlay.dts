/dts-v1/;
/plugin/;

/ {
	compatible = "brcm,bcm2835";

	fragment@0 {
		target = <&i2c1>;

		__overlay__ {
			#address-cells = <1>;
			#size-cells = <0>;
			status = "okay";

			mcp23008_6: mcp23008@26 {
				compatible = "microchip,mcp23008";
				reg = <0x26>;
				gpio-controller;
				status = "okay";
			};
		};
	};
};