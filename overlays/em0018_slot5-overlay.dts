/dts-v1/;
/plugin/;

/ {
	compatible = "brcm,bcm2835";

	fragment@0 {
		target = <&i2c1>;

		__overlay__ {
			#address-cells = <1>;
			#size-cells = <0>;
			status = "okay";

			mcp23008_5: mcp23008@25 {
				compatible = "microchip,mcp23008";
				reg = <0x25>;
				gpio-controller;
				status = "okay";
			};
		};
	};
};