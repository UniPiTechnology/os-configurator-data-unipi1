/dts-v1/;
/plugin/;

/ {
	fragment@0 {
		target = <&i2c1>;

		__overlay__ {
			#address-cells = <1>;
			#size-cells = <0>;
			status = "okay";

			mcp7940x@6f {
				compatible = "microchip,mcp7941x";
				reg = <0x6f>;
				status = "okay";
			};
		};
	};
};
