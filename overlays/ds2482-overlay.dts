/dts-v1/;
/plugin/;

/ {
/*	compatible = "brcm,bcm2835"; */

	fragment@0 {
		target = <&i2c1>;

		__overlay__ {
			#address-cells = <1>;
			#size-cells = <0>;
			status = "okay";

			ds2482: ds2482@18 {
				compatible = "maxim,ds2482";
				reg = <0x18>;
				status = "okay";
			};
		};
	};
};
